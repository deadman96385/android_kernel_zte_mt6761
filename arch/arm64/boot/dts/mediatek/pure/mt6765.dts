/*****************************************
Do not modify dts file, please modify according dtsi file
******************************************/

#include "../mt6765.dts"
#include "mtk_base_diff.dtsi"
