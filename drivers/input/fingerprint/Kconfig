## drivers/input/fingerprint/Kconfig
```kconfig
#
#Fingerprint
#
menu "Fingerprint support"
	depends on INPUT

config MTK_FINGERPRINT_SUPPORT
	bool "Mediatek Fingerprint"
	default n
	---help---
	Fingerprint mtk driver enable/disable in the kernel.
	Say Y here if you want to use mediatek fingerprint driver,
	fingerprint driver will support fingerprint function

if MTK_FINGERPRINT_SUPPORT

config GOODIX_FINGERPRINT
	bool "Goodix Fingerprint"
	default n
	---help---
	Goodix Fingerprint chip GF316M/GF318M/GF3118M/GF518M/GF5118M/GF516M/GF816M/GF3208/GF3206/GF3266/GF3288/GF5206/GF5216/GF5208 TEE driver

config GOODIX_SENSOR_TYPE
	string "SENSOR_TYPE"
	default "GF3658"
	---help---
	Must input sensor type, or default is GF316M GF318M GF3118M GF518M GF5118M GF516M GF816M GF3208 GF3206 GF3266 GF3288 GF5206 GF5216 GF5208

source "drivers/input/fingerprint/silead/Kconfig"

endif
endmenu
```

## drivers/input/touchscreen/vendor/Kconfig
```kconfig
#
# Touchscreen driver configuration
#
menuconfig INPUT_TOUCHSCREEN
	bool "Touchscreens"
	help
	  Say Y here, and a list of supported touchscreens will be displayed.
	  This option doesn't affect the kernel.

	  If unsure, say Y.

if INPUT_TOUCHSCREEN

config TOUCHSCREEN_VENDOR
	bool "Vendor Touch Panel Driver"
	help
	  Say Y here if you have Vendor touch panel.

	  If unsure, say N.

	  To compile this dirver as a module, choose M here: the
	  module will be called.

if TOUCHSCREEN_VENDOR

source "drivers/input/touchscreen/vendor/synaptics_2.7/Kconfig"
config TOUCHSCREEN_HIMAX_CHIPSET
	bool "Himax touchpanel CHIPSET"
	depends on I2C
	help
	  Say Y here if you have a Himax CHIPSET touchscreen.
	  HIMAX controllers are multi touch controllers which can
	  report 10 touches at a time.

          If unsure, say N.
if TOUCHSCREEN_HIMAX_CHIPSET
source "drivers/input/touchscreen/vendor/hxchipset/Kconfig"
endif

config TOUCHSCREEN_FTS_V2_1
	bool "Focaltech Touchscreen"
		depends on I2C
		default n
		help
		  Say Y here if you have Focaltech touch panel.
		  If unsure, say N.
if TOUCHSCREEN_FTS_V2_1
source "drivers/input/touchscreen/vendor/focaltech_touch_V2_1/Kconfig"
endif

config TOUCHSCREEN_TLSC6X
	bool "Focaltech Touchscreen"
		depends on I2C
		default n
		help
		  Say Y here if you have tlsc6x touch panel.
		  If unsure, say N.
if TOUCHSCREEN_TLSC6X
source "drivers/input/touchscreen/vendor/tlsc6x/Kconfig"
endif

config TS_FIRMWARE
	string "config board firmware folder"

config TP_COMMON_INTERFACE
	bool "Open TP common interface"
	depends on I2C
	help
	  Say Y here if you want to use TP common interface.

	  If unsure, say N.

endif

source "drivers/input/touchscreen/vendor/chipone_tddi/Kconfig"
source "drivers/input/touchscreen/vendor/focaltech_touch_v3/Kconfig"

endif
```

## drivers/input/touchscreen/vendor/chipone_tddi/Kconfig
```kconfig
#
# Focaltech Touchscreen driver configuration
#

config TOUCHSCREEN_CHIPONE
	bool "chipone touchpanel incell tp"
	depends on I2C
	default n
	help
	  Say Y here if you have chipone touchscreen.
	  chipone controllers are multi touch controllers which can
	  report 10 touches at a time.
	  If unsure, say N.
```

## drivers/input/touchscreen/vendor/focaltech_touch_V2_1/Kconfig
```kconfig
#
# Focaltech Touchscreen driver configuration
#

config TOUCHSCREEN_FTS_DIRECTORY
	string "Focaltech ts directory name"
	default "focaltech_touch"
	depends on TOUCHSCREEN_FTS_V2_1

config TS_FTS_MTK_INTERFACE
	tristate "Focaltech driver test over Dragon Board"
	depends on TOUCHSCREEN_FTS_V2_1
	help
	  This enables support for Focaltech driver in MTK platform.
```

## drivers/input/touchscreen/vendor/tlsc6x/Kconfig
```kconfig
#
# tlsc6x touchscreen driver configuration
#

config TS_TLSC6X_MTK_INTERFACE
	tristate "tlsc6x driver test over Dragon Board"
	depends on TOUCHSCREEN_TLSC6X
	help
	  This enables support for tlsc6x driver in MTK platform.
```

## drivers/misc/mediatek/optee_linuxdriverV2.0/Kconfig
```kconfig
# Generic Trusted Execution Environment Configuration
config ZTE_TEE_SUPPORT
	bool "Trusted Execution Environment support"
	default n
	help
	  This implements a generic interface towards a Trusted Execution
	  Environment (TEE).

#if ZTE_TEE_SUPPORT

#menu "TEE drivers"

#source "drivers/misc/mediatek/optee_linuxdriverV2.0/optee/Kconfig"

#endmenu

#endif
```

## drivers/misc/mediatek/optee_linuxdriverV2.0/optee/Kconfig
```kconfig
# OP-TEE Trusted Execution Environment Configuration
config ZTE_TEE_SUPPORT
	tristate "OP-TEE"
	default n
	depends on HAVE_ARM_SMCCC
	help
	  This implements the OP-TEE Trusted Execution Environment (TEE)
	  driver.
```

## drivers/misc/mediatek/sensors-1.0/accelerometer/kxtj2_1009/Kconfig
```kconfig
config MTK_KXTJ2_1009
	bool "KXTJ2_1009 for MediaTek package"
	default n
	help
	  It support different accelerometer sensor.
          If this option is set,
	  it will support
          KXTJ2_1009 Accelerometer.

config CUSTOM_KERNEL_SENSORHUB
	bool "MTK_KXTJ2_1009 for Mediatek package"
	default n
	help
	Say Y here if you have MTK_KXTJ2_1009 touch panel CUSTOM_KERNEL_SENSORHUB.

	If unsure, say N.

	To compile this dirver as a module, choose M here: the
	module will be called.
```

## drivers/misc/mediatek/sensors-1.0/accelerometer/stk8baxx/Kconfig
```kconfig
config MTK_STK8BAXX
	bool "STK8BAXX for MediaTek package"
	default y
	help
        If this option is set, it will support stk8baxx Accelerometer.
```

## drivers/misc/mediatek/sensors-1.0/sar_sensor/Kconfig
```kconfig
config CUSTOM_KERNEL_SAR_SENSOR
	bool "CUSTOM KERNEL SAR Config"
	help
	  To detect sar sensor

config CUSTOM_sx932x
	bool "CUSTOM KERNEL SAR sx932x Config"
	help
	  To enable SAR sx932x sensor
```

## drivers/soc/zte/vcfg/Kconfig
```kconfig
config VENDOR_CONFIG_HELPER
	bool "VENDOR CONFIG HELPER"
	default y
	help
	  Say 'y' here to include support for vendor config helper.
```
